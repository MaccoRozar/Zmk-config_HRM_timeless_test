## config/west.yml
```yaml
manifest:
  defaults:
    remote: MaccoRozar
    
  remotes:
    - name: MaccoRozar
      url-base: https://github.com/MaccoRozar
    - name: zmkfirmware
      url-base: https://github.com/zmkfirmware
  projects:
    - name: zmk
      remote: zmkfirmware
      revision: main
      import: app/west.yml
    - name: zmk-helpers
      path: modules/zmk/helpers
  self:
    path: config
```
